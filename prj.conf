## CMakeLists.txt
```
# SPDX-License-Identifier: Apache-2.0

cmake_minimum_required(VERSION 3.20.0)

find_package(Zephyr REQUIRED HINTS $ENV{ZEPHYR_BASE})
project(hpadv2)

target_sources(app PRIVATE
	src/main.c
	src/radio_esb.c
	src/radio_identity.c
	src/usb_device.c
	src/hid_consumer.c
	src/hid_vendor.c
	src/dongle_config.c
	src/consumer_action_engine.c
)
```

## prj.conf
```kconfig
CONFIG_MULTITHREADING=y
CONFIG_STDOUT_CONSOLE=y
CONFIG_HEAP_MEM_POOL_SIZE=16384
CONFIG_MAIN_STACK_SIZE=2048
CONFIG_SYSTEM_WORKQUEUE_STACK_SIZE=2048

CONFIG_LOG=y
CONFIG_LOG_MODE_DEFERRED=y
CONFIG_LOG_PROCESS_THREAD_STARTUP_DELAY_MS=4000
CONFIG_LOG_PROCESS_THREAD_SLEEP_MS=10
CONFIG_LOG_PROCESS_TRIGGER_THRESHOLD=1
CONFIG_LOG_BUFFER_SIZE=4096
CONFIG_UDC_DRIVER_LOG_LEVEL_WRN=y
CONFIG_CONSOLE=y
CONFIG_SERIAL=y
CONFIG_UART_CONSOLE=y
CONFIG_GPIO=y
CONFIG_ESB=y
CONFIG_ENTROPY_GENERATOR=y
CONFIG_SETTINGS=y
CONFIG_SETTINGS_NVS=y
CONFIG_FLASH=y
CONFIG_FLASH_MAP=y
CONFIG_NVS=y
CONFIG_MPU_ALLOW_FLASH_WRITE=y

# Disable the board's standalone CDC ACM serial backend so our composite
# USBD context (dongle_usbd) can register both HID and cdc_acm_0 itself.
CONFIG_CDC_ACM_SERIAL_INITIALIZE_AT_BOOT=n
```

## app.overlay
```dts
/ {
	hid_0: hid_0 {
		compatible = "zephyr,hid-device";
		label = "Consumer Control";
		protocol-code = "none";
		in-report-size = <2>;
		in-polling-period-us = <1000>;
	};

	hid_1: hid_1 {
		compatible = "zephyr,hid-device";
		label = "Macropad Vendor";
		protocol-code = "none";
		in-report-size = <3>;
		in-polling-period-us = <1000>;
	};
};
```

## src/main.c
```c
#include <errno.h>

#include <zephyr/device.h>
#include <zephyr/drivers/gpio.h>
#include <zephyr/kernel.h>
#include <zephyr/logging/log.h>
#include <zephyr/sys/util.h>

#include "consumer_action_engine.h"
#include "dongle_config.h"
#include "hid_vendor.h"
#include "radio_esb.h"
#include "radio_identity.h"
#include "usb_device.h"

LOG_MODULE_REGISTER(main, LOG_LEVEL_INF);

#define LED_NODE DT_ALIAS(led0)
#define RX_BLINK_MS 100
#define MACROPAD_KEY_MASK BIT_MASK(6)
#define MACROPAD_CONNECTION_TIMEOUT_MS 2500

static const struct gpio_dt_spec status_led = GPIO_DT_SPEC_GET(LED_NODE, gpios);
static struct k_work_delayable led_off_work;
static struct k_work_delayable macropad_disconnect_work;
static bool macropad_connected;

static void macropad_disconnect_work_handler(struct k_work *work);
static void handle_macropad_config(const macropad_config_t *config);

static void led_off_work_handler(struct k_work *work)
{
	int rc;

	ARG_UNUSED(work);

	rc = gpio_pin_set_dt(&status_led, 0);
	if (rc != 0) {
		LOG_ERR("Failed to turn LED off: %d", rc);
	}
}

static int status_led_init(void)
{
	int rc;

	if (!gpio_is_ready_dt(&status_led)) {
		return -ENODEV;
	}

	k_work_init_delayable(&led_off_work, led_off_work_handler);
	k_work_init_delayable(&macropad_disconnect_work, macropad_disconnect_work_handler);
	rc = gpio_pin_configure_dt(&status_led, GPIO_OUTPUT_INACTIVE);
	if (rc != 0) {
		LOG_ERR("Failed to configure status LED: %d", rc);
		return rc;
	}

	LOG_INF("Status LED initialized on port=%s pin=%u", status_led.port->name, status_led.pin);
	return 0;
}

static void blink_status_led_once(void)
{
	int rc;

	rc = gpio_pin_set_dt(&status_led, 1);
	if (rc != 0) {
		LOG_ERR("Failed to turn LED on: %d", rc);
		return;
	}

	(void)k_work_reschedule(&led_off_work, K_MSEC(RX_BLINK_MS));
}

static void forward_macropad_report(const macropad_report_t *report, bool connected)
{
	host_macropad_report_t host_report = {
		.connected = connected ? 1U : 0U,
		.keys = report->keys,
		.encoder_delta = report->encoder_delta,
		.encoder_pressed = report->encoder_pressed,
		.battery_mv = report->battery_mv,
		.usb_power_present = report->usb_power_present,
	};

	(void)hid_vendor_forward_macropad_report(&host_report);
}

static void macropad_disconnect_work_handler(struct k_work *work)
{
	const macropad_report_t report = {
		.keys = 0U,
		.encoder_delta = 0,
		.encoder_pressed = 0U,
		.battery_mv = 0U,
		.usb_power_present = 0U,
	};

	ARG_UNUSED(work);

	if (!macropad_connected) {
		return;
	}

	macropad_connected = false;
	consumer_action_engine_reset();
	forward_macropad_report(&report, false);
}

static void handle_macropad_report(const macropad_report_t *report)
{
	uint8_t unsupported_keys;
	bool input_activity;

	macropad_connected = true;
	(void)k_work_reschedule(&macropad_disconnect_work,
		K_MSEC(MACROPAD_CONNECTION_TIMEOUT_MS));
	forward_macropad_report(report, true);

	unsupported_keys = report->keys & (uint8_t)~MACROPAD_KEY_MASK;
	if (unsupported_keys != 0U) {
		LOG_WRN("Ignoring unsupported key bits: 0x%02x", unsupported_keys);
	}

	input_activity = consumer_action_engine_input_activity(report);
	if (input_activity) {
		blink_status_led_once();
	}

	consumer_action_engine_process_report(report);
}

static void handle_macropad_config(const macropad_config_t *config)
{
	int rc = radio_esb_queue_macropad_config(config);

	if (rc != 0) {
		LOG_WRN("Failed to queue macropad config: %d", rc);
	}
}

int main(void)
{
	struct dongle_identity identity;
	struct esb_addr_config addr_config;
	uint8_t rf_channel;
	bool generated;
	int rc;

	LOG_INF("Dongle boot start");

	LOG_INF("Initializing dongle config");
	rc = dongle_config_init();
	if (rc != 0) {
		LOG_ERR("dongle_config_init failed: %d", rc);
		return 0;
	}

	LOG_INF("Initializing USB composite HID + CDC ACM");
	hid_vendor_set_config_handler(handle_macropad_config);
	rc = usb_device_init();
	if (rc != 0) {
		LOG_ERR("usb_device_init failed: %d", rc);
		return 0;
	}

	LOG_INF("Initializing status LED");
	rc = status_led_init();
	if (rc != 0) {
		LOG_ERR("status_led_init failed: %d", rc);
		return 0;
	}
	blink_status_led_once();

	LOG_INF("Initializing persistent identity settings");
	rc = radio_identity_init();
	if (rc != 0) {
		LOG_ERR("radio_identity_init failed: %d", rc);
		return 0;
	}

	LOG_INF("Loading or creating dongle identity");
	rc = radio_identity_load_or_create(&identity, &generated);
	if (rc != 0) {
		LOG_ERR("radio_identity_load_or_create failed: %d", rc);
		return 0;
	}

	LOG_INF("Dongle identity synchronized");

	rc = radio_identity_derive_esb_config(&identity, &addr_config, &rf_channel);
	if (rc != 0) {
		LOG_ERR("radio_identity_derive_esb_config failed: %d", rc);
		return 0;
	}

	radio_identity_log_esb_config(&addr_config, rf_channel);

	LOG_INF("Initializing ESB receiver");
	rc = radio_esb_init(&addr_config, rf_channel, handle_macropad_report);
	if (rc != 0) {
		LOG_ERR("radio_esb_init failed: %d", rc);
		return 0;
	}

	LOG_INF("Starting ESB RX");
	rc = radio_esb_start();
	if (rc != 0) {
		LOG_ERR("radio_esb_start failed: %d", rc);
		return 0;
	}

	LOG_INF("Dongle ready and listening for macropad packets");

	while (true) {
		k_sleep(K_FOREVER);
	}

	return 0;
}
```

## src/button.c
```c
#include "button.h"

#include <errno.h>
#include <stdbool.h>

#include <zephyr/device.h>
#include <zephyr/drivers/gpio.h>
#include <zephyr/kernel.h>
#include <zephyr/logging/log.h>

LOG_MODULE_REGISTER(button, LOG_LEVEL_INF);

#define BUTTON_NODE DT_ALIAS(sw0)
#define BUTTON_DEBOUNCE_MS 25

static const struct gpio_dt_spec button = GPIO_DT_SPEC_GET(BUTTON_NODE, gpios);
static struct gpio_callback button_cb_data;
static struct k_work_delayable button_debounce_work;
static button_press_callback_t button_press_callback;
static bool button_latched;

static void button_debounce_work_handler(struct k_work *work)
{
	int state;

	ARG_UNUSED(work);

	state = gpio_pin_get_dt(&button);
	if (state < 0) {
		LOG_ERR("Failed to sample button state: %d", state);
		return;
	}

	if (state == 0) {
		if (!button_latched) {
			button_latched = true;
			LOG_INF("Button press detected on P0.09");
			if (button_press_callback != NULL) {
				button_press_callback();
			}
		}

		(void)k_work_reschedule(&button_debounce_work, K_MSEC(BUTTON_DEBOUNCE_MS));
		return;
	}

	button_latched = false;
}

static void button_gpio_isr(const struct device *port, struct gpio_callback *cb, uint32_t pins)
{
	ARG_UNUSED(port);
	ARG_UNUSED(cb);
	ARG_UNUSED(pins);

	(void)k_work_reschedule(&button_debounce_work, K_MSEC(BUTTON_DEBOUNCE_MS));
}

int button_init(button_press_callback_t callback)
{
	int rc;

	if (!gpio_is_ready_dt(&button)) {
		return -ENODEV;
	}

	button_press_callback = callback;
	button_latched = false;
	k_work_init_delayable(&button_debounce_work, button_debounce_work_handler);

	rc = gpio_pin_configure_dt(&button, GPIO_INPUT);
	if (rc != 0) {
		LOG_ERR("Failed to configure button GPIO: %d", rc);
		return rc;
	}

	rc = gpio_pin_interrupt_configure_dt(&button, GPIO_INT_EDGE_TO_ACTIVE);
	if (rc != 0) {
		LOG_ERR("Failed to configure button interrupt: %d", rc);
		return rc;
	}

	gpio_init_callback(&button_cb_data, button_gpio_isr, BIT(button.pin));
	rc = gpio_add_callback(button.port, &button_cb_data);
	if (rc != 0) {
		LOG_ERR("Failed to add button callback: %d", rc);
		return rc;
	}

	LOG_INF("Button initialized on port=%s pin=%u", button.port->name, button.pin);
	return 0;
}
```

## src/button.h
```c
#ifndef HPADV2_BUTTON_H_
#define HPADV2_BUTTON_H_

typedef void (*button_press_callback_t)(void);

int button_init(button_press_callback_t callback);

#endif
```

## src/consumer_action_engine.c
```c
#include "consumer_action_engine.h"

#include <zephyr/logging/log.h>
#include <zephyr/sys/util.h>

#include "dongle_config.h"
#include "hid_consumer.h"

LOG_MODULE_REGISTER(consumer_action_engine, LOG_LEVEL_INF);

#define MACROPAD_KEY_MASK BIT_MASK(KEY_COUNT)

static uint8_t previous_keys;
static bool previous_encoder_pressed;

void consumer_action_engine_reset(void)
{
	previous_keys = 0U;
	previous_encoder_pressed = false;
}

bool consumer_action_engine_input_activity(const macropad_report_t *report)
{
	uint8_t current_keys = report->keys & MACROPAD_KEY_MASK;

	return (current_keys != previous_keys) ||
		(report->encoder_delta != 0) ||
		(previous_encoder_pressed != (report->encoder_pressed != 0U));
}

void consumer_action_engine_process_report(const macropad_report_t *report)
{
	uint8_t current_keys = report->keys & MACROPAD_KEY_MASK;
	uint8_t newly_pressed = current_keys & ~previous_keys;
	bool encoder_pressed_now = (report->encoder_pressed != 0U);
	int rc;

	for (uint8_t i = 0; i < KEY_COUNT; i++) {
		if (newly_pressed & BIT(i)) {
			uint16_t action = dongle_config_action_for_key(i);

			if (action != ACTION_NONE) {
				rc = hid_consumer_trigger_action(action);

				if (rc != 0) {
					LOG_WRN("HID action key=%u action=%u failed: %d",
						i, action, rc);
				}
			}
		}
	}

	if (report->encoder_delta != 0) {
		uint16_t action = (report->encoder_delta > 0)
			? DONGLE_ACTION_VOLUME_UP
			: DONGLE_ACTION_VOLUME_DOWN;
		int steps = (report->encoder_delta > 0)
			? report->encoder_delta
			: -report->encoder_delta;

		for (int s = 0; s < steps; s++) {
			rc = hid_consumer_trigger_action(action);

			if (rc != 0) {
				LOG_WRN("HID encoder volume action=%u failed: %d", action, rc);
			}
		}
	}

	if (!previous_encoder_pressed && encoder_pressed_now) {
		rc = hid_consumer_trigger_action(DONGLE_ACTION_MUTE);

		if (rc != 0) {
			LOG_WRN("HID encoder mute action failed: %d", rc);
		}
	}

	previous_keys = current_keys;
	previous_encoder_pressed = encoder_pressed_now;
}
```

## src/consumer_action_engine.h
```c
#ifndef HPADV2_CONSUMER_ACTION_ENGINE_H_
#define HPADV2_CONSUMER_ACTION_ENGINE_H_

#include <stdbool.h>

#include "wire_protocol.h"

void consumer_action_engine_reset(void);
bool consumer_action_engine_input_activity(const macropad_report_t *report);
void consumer_action_engine_process_report(const macropad_report_t *report);

#endif
```

## src/dongle_config.c
```c
#include "dongle_config.h"

#include <errno.h>
#include <stdbool.h>
#include <string.h>

#include <zephyr/logging/log.h>
#include <zephyr/settings/settings.h>

LOG_MODULE_REGISTER(dongle_config, LOG_LEVEL_INF);

#define DONGLE_CONFIG_SETTINGS_ROOT "dongle_cfg"
#define DONGLE_CONFIG_SETTINGS_KEY DONGLE_CONFIG_SETTINGS_ROOT "/map"

static const dongle_config_t default_config = {
	.action_id = {
		ACTION_NONE,
		ACTION_NONE,
		ACTION_NONE,
		ACTION_NONE,
		ACTION_NONE,
		ACTION_NONE,
	},
};

static dongle_config_t stored_config;
static bool stored_config_loaded;

static int dongle_config_settings_set(const char *name, size_t len_rd,
				      settings_read_cb read_cb, void *cb_arg)
{
	int rc;

	if (!settings_name_steq(name, "map", NULL)) {
		return -ENOENT;
	}

	if (len_rd != sizeof(stored_config)) {
		LOG_WRN("Stored config length %zu does not match expected %zu",
			len_rd, sizeof(stored_config));
		stored_config_loaded = false;
		return 0;
	}

	rc = read_cb(cb_arg, &stored_config, sizeof(stored_config));
	if (rc < 0) {
		return rc;
	}

	if (rc != sizeof(stored_config)) {
		LOG_WRN("Settings read returned %d bytes for config", rc);
		stored_config_loaded = false;
		return 0;
	}

	stored_config_loaded = true;
	return 0;
}

SETTINGS_STATIC_HANDLER_DEFINE(dongle_config, DONGLE_CONFIG_SETTINGS_ROOT, NULL,
			      dongle_config_settings_set, NULL, NULL);

int dongle_config_init(void)
{
	int rc;

	stored_config = default_config;
	stored_config_loaded = false;

	rc = settings_load_subtree(DONGLE_CONFIG_SETTINGS_ROOT);
	if (rc != 0) {
		LOG_WRN("settings_load_subtree failed: %d, using defaults", rc);
		return 0;
	}

	if (stored_config_loaded) {
		LOG_INF("Loaded persisted key-action mapping");
		return 0;
	}

	rc = settings_save_one(DONGLE_CONFIG_SETTINGS_KEY,
			       &default_config, sizeof(default_config));
	if (rc != 0) {
		LOG_WRN("settings_save_one failed: %d, continuing with defaults", rc);
		return 0;
	}

	stored_config = default_config;
	stored_config_loaded = true;
	LOG_INF("Stored default key-action mapping");
	return 0;
}

const dongle_config_t *dongle_config_get(void)
{
	return &stored_config;
}

uint16_t dongle_config_action_for_key(uint8_t key_index)
{
	if (key_index >= KEY_COUNT) {
		return ACTION_NONE;
	}

	return stored_config.action_id[key_index];
}
```

## src/dongle_config.h
```c
#ifndef HPADV2_DONGLE_CONFIG_H_
#define HPADV2_DONGLE_CONFIG_H_

#include <stdint.h>

#include <zephyr/toolchain.h>

#define KEY_COUNT 6U
#define ACTION_NONE 0U

enum dongle_action_id {
	DONGLE_ACTION_VOLUME_UP = 1,
	DONGLE_ACTION_VOLUME_DOWN = 2,
	DONGLE_ACTION_MUTE = 3,
	DONGLE_ACTION_NEXT_TRACK = 4,
	DONGLE_ACTION_PREVIOUS_TRACK = 5,
	DONGLE_ACTION_STOP = 6,
	DONGLE_ACTION_PLAY_PAUSE = 7,
};

typedef struct __packed {
	uint16_t action_id[KEY_COUNT];
} dongle_config_t;

int dongle_config_init(void);
const dongle_config_t *dongle_config_get(void);
uint16_t dongle_config_action_for_key(uint8_t key_index);

#endif
```

## src/hid_consumer.c
```c
#include "hid_consumer.h"

#include <errno.h>

#include <zephyr/device.h>
#include <zephyr/kernel.h>
#include <zephyr/logging/log.h>
#include <zephyr/drivers/usb/udc_buf.h>
#include <zephyr/sys/atomic.h>
#include <zephyr/sys/byteorder.h>
#include <zephyr/usb/class/hid.h>
#include <zephyr/usb/class/usbd_hid.h>
#include <zephyr/usb/usbd.h>

#include "dongle_config.h"
#include "usb_device.h"

LOG_MODULE_REGISTER(hid_consumer, LOG_LEVEL_INF);

#define USB_CONSUMER_USAGE_PAGE 0x0CU
#define USB_CONSUMER_USAGE_CONSUMER_CONTROL 0x01U
#define USB_CONSUMER_USAGE_MUTE 0x00E2U
#define USB_CONSUMER_USAGE_VOLUME_INCREMENT 0x00E9U
#define USB_CONSUMER_USAGE_VOLUME_DECREMENT 0x00EAU
#define USB_CONSUMER_USAGE_PLAY_PAUSE 0x00CDU
#define USB_CONSUMER_USAGE_SCAN_NEXT_TRACK 0x00B5U
#define USB_CONSUMER_USAGE_SCAN_PREVIOUS_TRACK 0x00B6U
#define USB_CONSUMER_USAGE_STOP 0x00B7U
#define USB_HID_CONSUMER_QUEUE_LEN 32

static const struct device *const consumer_hid_dev = DEVICE_DT_GET(DT_NODELABEL(hid_0));

static const uint8_t consumer_hid_report_desc[] = {
	HID_USAGE_PAGE(USB_CONSUMER_USAGE_PAGE),
	HID_USAGE(USB_CONSUMER_USAGE_CONSUMER_CONTROL),
	HID_COLLECTION(HID_COLLECTION_APPLICATION),
	HID_LOGICAL_MIN8(0x00),
	HID_LOGICAL_MAX16(0xFF, 0x03),
	HID_USAGE_MIN8(0x00),
	HID_USAGE_MAX16(0xFF, 0x03),
	HID_REPORT_SIZE(16),
	HID_REPORT_COUNT(1),
	HID_INPUT(0x00),
	HID_END_COLLECTION,
};

UDC_STATIC_BUF_DEFINE(consumer_hid_buf, sizeof(uint16_t));
K_MSGQ_DEFINE(consumer_report_queue, sizeof(uint16_t), USB_HID_CONSUMER_QUEUE_LEN, 4);

static struct k_work consumer_hid_work;
static bool consumer_hid_ready;
static atomic_t consumer_submit_pending;

static void hid_consumer_work_handler(struct k_work *work)
{
	uint16_t report;
	int rc;

	ARG_UNUSED(work);

	if (!usb_device_is_initialized() || !consumer_hid_ready) {
		return;
	}

	if (!atomic_cas(&consumer_submit_pending, 0, 1)) {
		return;
	}

	if (k_msgq_get(&consumer_report_queue, &report, K_NO_WAIT) != 0) {
		atomic_set(&consumer_submit_pending, 0);
		return;
	}

	sys_put_le16(report, consumer_hid_buf);
	rc = hid_device_submit_report(consumer_hid_dev, sizeof(uint16_t), consumer_hid_buf);
	if (rc != 0) {
		LOG_WRN("Consumer HID submit failed: %d", rc);
		atomic_set(&consumer_submit_pending, 0);
	}
}

static void hid_consumer_submit_work(void)
{
	usb_device_submit_work(&consumer_hid_work);
}

static void hid_consumer_input_report_done(const struct device *dev,
					   const uint8_t *const buf)
{
	ARG_UNUSED(dev);
	ARG_UNUSED(buf);
	atomic_set(&consumer_submit_pending, 0);
	hid_consumer_submit_work();
}

static uint16_t hid_consumer_usage_for_action(uint16_t action_id)
{
	switch (action_id) {
	case DONGLE_ACTION_VOLUME_UP:
		return USB_CONSUMER_USAGE_VOLUME_INCREMENT;
	case DONGLE_ACTION_VOLUME_DOWN:
		return USB_CONSUMER_USAGE_VOLUME_DECREMENT;
	case DONGLE_ACTION_MUTE:
		return USB_CONSUMER_USAGE_MUTE;
	case DONGLE_ACTION_NEXT_TRACK:
		return USB_CONSUMER_USAGE_SCAN_NEXT_TRACK;
	case DONGLE_ACTION_PREVIOUS_TRACK:
		return USB_CONSUMER_USAGE_SCAN_PREVIOUS_TRACK;
	case DONGLE_ACTION_STOP:
		return USB_CONSUMER_USAGE_STOP;
	case DONGLE_ACTION_PLAY_PAUSE:
		return USB_CONSUMER_USAGE_PLAY_PAUSE;
	default:
		return 0U;
	}
}

static void hid_consumer_iface_ready(const struct device *dev, const bool ready)
{
	ARG_UNUSED(dev);

	consumer_hid_ready = ready;
	LOG_INF("Consumer control HID interface %s", ready ? "ready" : "not ready");
}

static int hid_consumer_get_report(const struct device *dev,
				   const uint8_t type, const uint8_t id,
				   const uint16_t len, uint8_t *const buf)
{
	ARG_UNUSED(dev);
	ARG_UNUSED(id);

	if (type != HID_REPORT_TYPE_INPUT) {
		return -ENOTSUP;
	}

	if (len < sizeof(uint16_t)) {
		return -EINVAL;
	}

	sys_put_le16(0U, buf);
	return sizeof(uint16_t);
}

static const struct hid_device_ops consumer_hid_ops = {
	.iface_ready = hid_consumer_iface_ready,
	.get_report = hid_consumer_get_report,
	.input_report_done = hid_consumer_input_report_done,
};

int hid_consumer_init(void)
{
	int rc;

	if (!device_is_ready(consumer_hid_dev)) {
		return -ENODEV;
	}

	k_work_init(&consumer_hid_work, hid_consumer_work_handler);
	rc = hid_device_register(consumer_hid_dev, consumer_hid_report_desc,
				 sizeof(consumer_hid_report_desc), &consumer_hid_ops);
	if (rc != 0) {
		LOG_ERR("consumer hid_device_register failed: %d", rc);
	}

	return rc;
}

int hid_consumer_trigger_action(uint16_t action_id)
{
	uint16_t usage_id;

	if (!usb_device_is_initialized()) {
		return -EAGAIN;
	}

	if (!consumer_hid_ready) {
		return -EAGAIN;
	}

	usage_id = hid_consumer_usage_for_action(action_id);
	if (usage_id == 0U) {
		return -ENOTSUP;
	}

	if (k_msgq_put(&consumer_report_queue, &usage_id, K_NO_WAIT) != 0) {
		return -ENOBUFS;
	}

	usage_id = 0U;
	if (k_msgq_put(&consumer_report_queue, &usage_id, K_NO_WAIT) != 0) {
		return -ENOBUFS;
	}

	hid_consumer_submit_work();
	return 0;
}
```

## src/hid_consumer.h
```c
#ifndef HPADV2_HID_CONSUMER_H_
#define HPADV2_HID_CONSUMER_H_

#include <stdint.h>

int hid_consumer_init(void);
int hid_consumer_trigger_action(uint16_t action_id);

#endif
```

## src/hid_vendor.c
```c
#include "hid_vendor.h"

#include <errno.h>
#include <stdbool.h>
#include <string.h>

#include <zephyr/device.h>
#include <zephyr/drivers/usb/udc_buf.h>
#include <zephyr/kernel.h>
#include <zephyr/logging/log.h>
#include <zephyr/sys/atomic.h>
#include <zephyr/spinlock.h>
#include <zephyr/usb/class/hid.h>
#include <zephyr/usb/class/usbd_hid.h>
#include <zephyr/usb/usbd.h>

#include "usb_device.h"

LOG_MODULE_REGISTER(hid_vendor, LOG_LEVEL_INF);

#define USB_VENDOR_USAGE_PAGE 0xFF00U
#define USB_VENDOR_USAGE 0xFF01U

static const struct device *const vendor_hid_dev = DEVICE_DT_GET(DT_NODELABEL(hid_1));

static const uint8_t vendor_hid_report_desc[] = {
	HID_ITEM(HID_ITEM_TAG_USAGE_PAGE, HID_ITEM_TYPE_GLOBAL, 2),
	(uint8_t)USB_VENDOR_USAGE_PAGE,
	(uint8_t)(USB_VENDOR_USAGE_PAGE >> 8),
	HID_USAGE16(USB_VENDOR_USAGE),
	HID_COLLECTION(HID_COLLECTION_APPLICATION),
	HID_LOGICAL_MIN8(0x00),
	HID_LOGICAL_MAX16(0xFF, 0x00),
	HID_REPORT_SIZE(8),
	HID_REPORT_COUNT(HPAD_USB_VENDOR_INPUT_REPORT_SIZE),
	HID_INPUT(0x02),
	HID_REPORT_COUNT(HPAD_USB_VENDOR_OUTPUT_REPORT_SIZE),
	HID_OUTPUT(0x02),
	HID_END_COLLECTION,
};

UDC_STATIC_BUF_DEFINE(vendor_hid_buf, HPAD_USB_VENDOR_INPUT_REPORT_SIZE);

static struct k_work vendor_hid_work;
static bool vendor_hid_ready;
static atomic_t vendor_submit_pending;
static hid_vendor_config_handler_t vendor_config_handler;

static struct k_spinlock vendor_slot_lock;
static host_macropad_report_t vendor_slot_report;
static bool vendor_slot_dirty;

static void hid_vendor_submit_work(void)
{
	usb_device_submit_work(&vendor_hid_work);
}

static void hid_vendor_input_report_done(const struct device *dev,
					 const uint8_t *const buf)
{
	ARG_UNUSED(dev);
	ARG_UNUSED(buf);
	atomic_set(&vendor_submit_pending, 0);
	hid_vendor_submit_work();
}

static void hid_vendor_iface_ready(const struct device *dev, const bool ready)
{
	ARG_UNUSED(dev);

	vendor_hid_ready = ready;
	LOG_INF("Vendor HID interface %s", ready ? "ready" : "not ready");
	if (ready) {
		hid_vendor_submit_work();
	}
}

static int hid_vendor_get_report(const struct device *dev,
				 const uint8_t type, const uint8_t id,
				 const uint16_t len, uint8_t *const buf)
{
	ARG_UNUSED(dev);
	ARG_UNUSED(id);

	if (type != HID_REPORT_TYPE_INPUT) {
		return -ENOTSUP;
	}

	if (len < HPAD_USB_VENDOR_INPUT_REPORT_SIZE) {
		return -EINVAL;
	}

	memset(buf, 0, HPAD_USB_VENDOR_INPUT_REPORT_SIZE);
	return HPAD_USB_VENDOR_INPUT_REPORT_SIZE;
}

static int hid_vendor_set_report(const struct device *dev,
				 const uint8_t type, const uint8_t id,
				 const uint16_t len, const uint8_t *const buf)
{
	const uint8_t *payload = buf;
	uint16_t payload_len = len;
	macropad_config_t config;

	ARG_UNUSED(dev);
	ARG_UNUSED(id);

	if (type != HID_REPORT_TYPE_OUTPUT) {
		return -ENOTSUP;
	}

	if ((payload_len == (HPAD_USB_VENDOR_OUTPUT_REPORT_SIZE + 1U)) &&
	    (payload[0] == 0U)) {
		payload++;
		payload_len--;
	}

	if (payload_len != sizeof(config)) {
		return -EINVAL;
	}

	memcpy(&config, payload, sizeof(config));
	if (config.kind != HPAD_PROTOCOL_CONFIG_KIND_KEY_COLORS) {
		return -EINVAL;
	}
	if (vendor_config_handler != NULL) {
		vendor_config_handler(&config);
	}

	return 0;
}

static const struct hid_device_ops vendor_hid_ops = {
	.iface_ready = hid_vendor_iface_ready,
	.get_report = hid_vendor_get_report,
	.set_report = hid_vendor_set_report,
	.input_report_done = hid_vendor_input_report_done,
};

static void hid_vendor_work_handler(struct k_work *work)
{
	host_macropad_report_t report;
	k_spinlock_key_t key;
	bool has_data;
	int rc;

	ARG_UNUSED(work);

	if (!usb_device_is_initialized() || !vendor_hid_ready) {
		return;
	}

	if (!atomic_cas(&vendor_submit_pending, 0, 1)) {
		return;
	}

	key = k_spin_lock(&vendor_slot_lock);
	has_data = vendor_slot_dirty;
	if (has_data) {
		report = vendor_slot_report;
		vendor_slot_dirty = false;
	}
	k_spin_unlock(&vendor_slot_lock, key);

	if (!has_data) {
		atomic_set(&vendor_submit_pending, 0);
		return;
	}

	memcpy(vendor_hid_buf, &report, sizeof(report));
	rc = hid_device_submit_report(vendor_hid_dev, sizeof(report), vendor_hid_buf);
	if (rc != 0) {
		LOG_DBG("Vendor HID submit failed: %d", rc);
		atomic_set(&vendor_submit_pending, 0);
	}
}

int hid_vendor_init(void)
{
	int rc;

	if (!device_is_ready(vendor_hid_dev)) {
		return -ENODEV;
	}

	k_work_init(&vendor_hid_work, hid_vendor_work_handler);
	rc = hid_device_register(vendor_hid_dev, vendor_hid_report_desc,
				 sizeof(vendor_hid_report_desc), &vendor_hid_ops);
	if (rc != 0) {
		LOG_ERR("vendor hid_device_register failed: %d", rc);
	}

	return rc;
}

void hid_vendor_set_config_handler(hid_vendor_config_handler_t handler)
{
	vendor_config_handler = handler;
}

int hid_vendor_forward_macropad_report(const host_macropad_report_t *report)
{
	k_spinlock_key_t key;

	if (report == NULL) {
		return -EINVAL;
	}

	if (!usb_device_is_initialized()) {
		return 0;
	}

	key = k_spin_lock(&vendor_slot_lock);
	vendor_slot_report = *report;
	vendor_slot_dirty = true;
	k_spin_unlock(&vendor_slot_lock, key);

	hid_vendor_submit_work();
	return 0;
}
```

## src/hid_vendor.h
```c
#ifndef HPADV2_HID_VENDOR_H_
#define HPADV2_HID_VENDOR_H_

#include "wire_protocol.h"

typedef void (*hid_vendor_config_handler_t)(const macropad_config_t *config);

int hid_vendor_init(void);
void hid_vendor_set_config_handler(hid_vendor_config_handler_t handler);
int hid_vendor_forward_macropad_report(const host_macropad_report_t *report);

#endif
```

## src/radio_esb.c
```c
#include "radio_esb.h"

#include <errno.h>
#include <stdbool.h>
#include <string.h>

#include <zephyr/kernel.h>
#include <zephyr/logging/log.h>
#include <zephyr/sys/atomic.h>
#include <zephyr/sys/util.h>

#if __has_include(<esb.h>)
#include <esb.h>

#define RADIO_ESB_PAYLOAD struct esb_payload
#define RADIO_ESB_EVENT struct esb_evt
#define RADIO_ESB_CONFIG struct esb_config
#define RADIO_ESB_DEFAULT_CONFIG ESB_DEFAULT_CONFIG
#define RADIO_ESB_EVENT_RX_RECEIVED ESB_EVENT_RX_RECEIVED
#define RADIO_ESB_EVENT_TX_SUCCESS ESB_EVENT_TX_SUCCESS
#define RADIO_ESB_EVENT_TX_FAILED ESB_EVENT_TX_FAILED
#define RADIO_ESB_PROTOCOL_DPL ESB_PROTOCOL_ESB_DPL
#define RADIO_ESB_BITRATE_2MBPS ESB_BITRATE_2MBPS
#define RADIO_ESB_MODE_PRX ESB_MODE_PRX
#define radio_esb_api_flush_rx esb_flush_rx
#define radio_esb_api_flush_tx esb_flush_tx
#define radio_esb_api_init esb_init
#define radio_esb_api_read_rx_payload esb_read_rx_payload
#define radio_esb_api_set_base_address_0 esb_set_base_address_0
#define radio_esb_api_set_base_address_1 esb_set_base_address_1
#define radio_esb_api_set_prefixes esb_set_prefixes
#define radio_esb_api_set_rf_channel esb_set_rf_channel
#define radio_esb_api_start_rx esb_start_rx
#define radio_esb_api_write_payload esb_write_payload
#elif __has_include(<nrf_esb.h>)
#include <nrf_esb.h>

#define RADIO_ESB_PAYLOAD nrf_esb_payload_t
#define RADIO_ESB_EVENT nrf_esb_evt_t
#define RADIO_ESB_CONFIG nrf_esb_config_t
#define RADIO_ESB_DEFAULT_CONFIG NRF_ESB_DEFAULT_CONFIG
#define RADIO_ESB_EVENT_RX_RECEIVED NRF_ESB_EVENT_RX_RECEIVED
#define RADIO_ESB_EVENT_TX_SUCCESS NRF_ESB_EVENT_TX_SUCCESS
#define RADIO_ESB_EVENT_TX_FAILED NRF_ESB_EVENT_TX_FAILED
#define RADIO_ESB_PROTOCOL_DPL NRF_ESB_PROTOCOL_ESB_DPL
#define RADIO_ESB_BITRATE_2MBPS NRF_ESB_BITRATE_2MBPS
#define RADIO_ESB_MODE_PRX NRF_ESB_MODE_PRX
#define radio_esb_api_flush_rx nrf_esb_flush_rx
#define radio_esb_api_flush_tx nrf_esb_flush_tx
#define radio_esb_api_init nrf_esb_init
#define radio_esb_api_read_rx_payload nrf_esb_read_rx_payload
#define radio_esb_api_set_base_address_0 nrf_esb_set_base_address_0
#define radio_esb_api_set_base_address_1 nrf_esb_set_base_address_1
#define radio_esb_api_set_prefixes nrf_esb_set_prefixes
#define radio_esb_api_set_rf_channel nrf_esb_set_rf_channel
#define radio_esb_api_start_rx nrf_esb_start_rx
#define radio_esb_api_write_payload nrf_esb_write_payload
#else
#error "Unable to find an ESB header for this SDK"
#endif

LOG_MODULE_REGISTER(radio_esb, LOG_LEVEL_INF);

#define RADIO_EVENT_RX BIT(0)

static struct k_work radio_work;
static struct k_mutex radio_tx_lock;
static atomic_t pending_events;
static radio_esb_report_handler_t macropad_report_handler;
static bool radio_initialized;

static void radio_esb_schedule_worker(void)
{
	(void)k_work_submit(&radio_work);
}

static void radio_esb_event_handler(const RADIO_ESB_EVENT *event)
{
	switch (event->evt_id) {
	case RADIO_ESB_EVENT_RX_RECEIVED:
		atomic_or(&pending_events, RADIO_EVENT_RX);
		break;
	default:
		break;
	}

	radio_esb_schedule_worker();
}

static void radio_esb_work_handler(struct k_work *work)
{
	RADIO_ESB_PAYLOAD payload;
	macropad_report_t report;
	int rc;
	atomic_val_t events;

	ARG_UNUSED(work);

	events = atomic_set(&pending_events, 0);
	if ((events & RADIO_EVENT_RX) == 0) {
		return;
	}

	memset(&payload, 0, sizeof(payload));
	while ((rc = radio_esb_api_read_rx_payload(&payload)) == 0) {
		if (payload.length != sizeof(report)) {
			LOG_WRN("Rejected payload on pipe %u len=%u: length mismatch",
				payload.pipe, payload.length);
			memset(&payload, 0, sizeof(payload));
			continue;
		}

		memcpy(&report, payload.data, sizeof(report));

		LOG_DBG("Macropad packet received: keys=0x%02x encoder_delta=%d encoder_pressed=%u",
			report.keys, report.encoder_delta, report.encoder_pressed);

		if (macropad_report_handler != NULL) {
			macropad_report_handler(&report);
		}

		memset(&payload, 0, sizeof(payload));
	}
}

int radio_esb_init(const struct esb_addr_config *addr_config, uint8_t rf_channel,
		   radio_esb_report_handler_t report_handler)
{
	RADIO_ESB_CONFIG config = RADIO_ESB_DEFAULT_CONFIG;
	int rc;

	if (addr_config == NULL) {
		return -EINVAL;
	}

	config.protocol = RADIO_ESB_PROTOCOL_DPL;
	config.bitrate = RADIO_ESB_BITRATE_2MBPS;
	config.mode = RADIO_ESB_MODE_PRX;
	config.event_handler = radio_esb_event_handler;
	config.selective_auto_ack = false;
	config.retransmit_delay = 600U;
	config.retransmit_count = 3U;
	config.payload_length = sizeof(macropad_report_t);

	k_work_init(&radio_work, radio_esb_work_handler);
	k_mutex_init(&radio_tx_lock);
	atomic_clear(&pending_events);
	macropad_report_handler = report_handler;

	rc = radio_esb_api_init(&config);
	if (rc != 0) {
		LOG_ERR("ESB init failed: %d", rc);
		return rc;
	}

	rc = radio_esb_api_set_base_address_0(addr_config->base_addr_0);
	if (rc != 0) {
		LOG_ERR("Failed to set base address 0: %d", rc);
		return rc;
	}

	rc = radio_esb_api_set_base_address_1(addr_config->base_addr_1);
	if (rc != 0) {
		LOG_ERR("Failed to set base address 1: %d", rc);
		return rc;
	}

	rc = radio_esb_api_set_prefixes(addr_config->prefixes, ARRAY_SIZE(addr_config->prefixes));
	if (rc != 0) {
		LOG_ERR("Failed to set prefixes: %d", rc);
		return rc;
	}

	rc = radio_esb_api_set_rf_channel(rf_channel);
	if (rc != 0) {
		LOG_ERR("Failed to set RF channel: %d", rc);
		return rc;
	}

	radio_initialized = true;
	LOG_INF("ESB initialized in PRX mode on channel %u", rf_channel);
	return 0;
}

int radio_esb_start(void)
{
	int rc;

	if (!radio_initialized) {
		return -EAGAIN;
	}

	radio_esb_api_flush_tx();
	radio_esb_api_flush_rx();
	rc = radio_esb_api_start_rx();
	if (rc != 0) {
		LOG_ERR("Failed to start ESB RX: %d", rc);
		return rc;
	}

	LOG_INF("ESB receiver started");
	return 0;
}

int radio_esb_queue_macropad_config(const macropad_config_t *config)
{
	RADIO_ESB_PAYLOAD payload;
	int rc;

	if (!radio_initialized) {
		return -EAGAIN;
	}
	if ((config == NULL) || (config->kind != HPAD_PROTOCOL_CONFIG_KIND_KEY_COLORS)) {
		return -EINVAL;
	}

	memset(&payload, 0, sizeof(payload));
	payload.pipe = 0U;
	payload.length = sizeof(*config);
	memcpy(payload.data, config, sizeof(*config));

	k_mutex_lock(&radio_tx_lock, K_FOREVER);
	radio_esb_api_flush_tx();
	rc = radio_esb_api_write_payload(&payload);
	k_mutex_unlock(&radio_tx_lock);
	if (rc != 0) {
		LOG_WRN("Failed to queue macropad config ACK payload: %d", rc);
		return rc;
	}

	LOG_INF("Queued macropad color config for ACK delivery");
	return 0;
}
```

## src/radio_esb.h
```c
#ifndef HPADV2_RADIO_ESB_H_
#define HPADV2_RADIO_ESB_H_

#include <stdint.h>

#include "radio_identity.h"
#include "wire_protocol.h"

typedef void (*radio_esb_report_handler_t)(const macropad_report_t *report);

int radio_esb_init(const struct esb_addr_config *addr_config, uint8_t rf_channel,
		   radio_esb_report_handler_t report_handler);
int radio_esb_start(void);
int radio_esb_queue_macropad_config(const macropad_config_t *config);

#endif
```
